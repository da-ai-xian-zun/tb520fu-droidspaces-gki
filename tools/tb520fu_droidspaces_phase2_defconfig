## tools/tb520fu_droidspaces_phase2_defconfig
```kconfig
# Droidspaces GKI phase-2 fragment (Kernel-Configuration.md §GKI Step 2)
# Applied via Bazel --defconfig_fragment; not written to gki_defconfig by savedefconfig.
CONFIG_DEVTMPFS=y
CONFIG_NETFILTER_XT_MATCH_ADDRTYPE=y
CONFIG_NETFILTER_XT_TARGET_LOG=y
CONFIG_NETFILTER_XT_MATCH_RECENT=y
CONFIG_IP_SET=y
CONFIG_IP_SET_HASH_IP=y
CONFIG_IP_SET_HASH_NET=y
CONFIG_NETFILTER_XT_SET=y
CONFIG_TMPFS_POSIX_ACL=y
CONFIG_TMPFS_XATTR=y
CONFIG_BLK_DEV_LOOP_MIN_COUNT=64
```
